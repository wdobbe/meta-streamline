## conf/layer.conf
```bitbake
# We have a conf and classes directory, add to BBPATH
BBPATH .= ":${LAYERDIR}"

# We have recipes-* directories, add to BBFILES
BBFILES += "${LAYERDIR}/recipes-*/*/*.bb \
	${LAYERDIR}/recipes-*/*/*.bbappend"

BBFILE_COLLECTIONS += "streamline-layer"
BBFILE_PATTERN_streamline-layer = "^${LAYERDIR}/"
BBFILE_PRIORITY_streamline-layer = "6"

LAYERVERSION_streamline-layer = "1"
LAYERSERIES_COMPAT_streamline-layer = "sumo"
```
